## general/package/fullhan-osdrv-fh8626v100/Config.in
```kconfig
config BR2_PACKAGE_FULLHAN_OSDRV_FH8626V100
	bool "fullhan-osdrv-fh8626v100"
	help
	  fullhan-osdrv-fh8626v100 - Fullhan kernel modules and libs

	  https://openipc.org
```
